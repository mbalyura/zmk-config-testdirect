## boards/shields/testdirect/Kconfig.defconfig
```kconfig
if SHIELD_TESTDIRECT

config ZMK_KEYBOARD_NAME
	default "Testdirect"

config ZMK_USB
	default y

config GPIO
	default y

config ZMK_KSAN_DIRECT_POLLING
	default y

endif
```
